//////////////////////////////////////////////////////////////////////////////////////////
//////////////////////////////////////////////////////////////////////////////////////////
//////////////////////////////////////////////////////////////////////////////////////////
// #### ##    ## #### ########    ########  ######  ########          ##    ##  #######  ##      ##
//  ##  ###   ##  ##     ##       ##       ##    ## ##     ##         ###   ## ##     ## ##  ##  ##
//  ##  ####  ##  ##     ##       ##       ##       ##     ##         ####  ## ##     ## ##  ##  ##
//  ##  ## ## ##  ##     ##       ######    ######  ########  ####### ## ## ## ##     ## ##  ##  ##
//  ##  ##  ####  ##     ##       ##             ## ##                ##  #### ##     ## ##  ##  ##
//  ##  ##   ###  ##     ##       ##       ##    ## ##                ##   ### ##     ## ##  ##  ##
// #### ##    ## ####    ##       ########  ######  ##                ##    ##  #######   ###  ###

void init_espnow_bridge()
{
    if (start_mqtt && use_mqtt && start_esp_now_bridge)
    {
        Serial.begin(115200);      // init serial
        Serial.flush();            // quick flush
        enb_flush_serial_buffer(); // flush serial buffer
        use_esp_now_bridge = true;
    }
}

//////////////////////////////////////////////////////////////////////////////////////////
//////////////////////////////////////////////////////////////////////////////////////////
//////////////////////////////////////////////////////////////////////////////////////////
// ##        #######   #######  ########
// ##       ##     ## ##     ## ##     ##
// ##       ##     ## ##     ## ##     ##
// ##       ##     ## ##     ## ########
// ##       ##     ## ##     ## ##
// ##       ##     ## ##     ## ##
// ########  #######   #######  ##

void enb_loop()
{
    if (Serial.available())
    {
        char c;

        if (enb_during_message)
            if ((unsigned long)(millis() - enb_accolade_start) > enb_max_time)
                enb_clear_buffer(false);

        while (Serial.available())
        {
            c = Serial.read();

            if (c == '{')
            {
                enb_accolade++;

                if (enb_accolade == 1)
                {
                    enb_accolade_start = millis();
                    enb_during_message = true;
                }
            }

            if (enb_accolade > 0)
            {
                enb_buffer[enb_position] = c;
                enb_position++;
                if (enb_position == 0)
                    enb_clear_buffer(true);
            }

            if (c == '}' && enb_accolade > 0)
                enb_accolade--;
        }

        if (enb_accolade == 0 && enb_position > 0)
            enb_relay_message();
    }
}

//////////////////////////////////////////////////////////////////////////////////////////
//////////////////////////////////////////////////////////////////////////////////////////
//////////////////////////////////////////////////////////////////////////////////////////
//  ######  ##       ########    ###    ########     ########  ##     ## ######## ######## ######## ########
// ##    ## ##       ##         ## ##   ##     ##    ##     ## ##     ## ##       ##       ##       ##     ##
// ##       ##       ##        ##   ##  ##     ##    ##     ## ##     ## ##       ##       ##       ##     ##
// ##       ##       ######   ##     ## ########     ########  ##     ## ######   ######   ######   ########
// ##       ##       ##       ######### ##   ##      ##     ## ##     ## ##       ##       ##       ##   ##
// ##    ## ##       ##       ##     ## ##    ##     ##     ## ##     ## ##       ##       ##       ##    ##
//  ######  ######## ######## ##     ## ##     ##    ########   #######  ##       ##       ######## ##     ##

void enb_clear_buffer(bool flush)
{
    for (uint16_t i = 0; i < 256; i++)
        enb_buffer[i] = 0;

    enb_position = 0;
    enb_accolade = 0;
    enb_during_message = false;

    if (flush)
        enb_flush_serial_buffer();
}

//////////////////////////////////////////////////////////////////////////////////////////
//////////////////////////////////////////////////////////////////////////////////////////
//////////////////////////////////////////////////////////////////////////////////////////
// ########  ######## ##          ###    ##    ##    ##     ## ########  ######   ######     ###     ######   ########
// ##     ## ##       ##         ## ##    ##  ##     ###   ### ##       ##    ## ##    ##   ## ##   ##    ##  ##
// ##     ## ##       ##        ##   ##    ####      #### #### ##       ##       ##        ##   ##  ##        ##
// ########  ######   ##       ##     ##    ##       ## ### ## ######    ######   ######  ##     ## ##   #### ######
// ##   ##   ##       ##       #########    ##       ##     ## ##             ##       ## ######### ##    ##  ##
// ##    ##  ##       ##       ##     ##    ##       ##     ## ##       ##    ## ##    ## ##     ## ##    ##  ##
// ##     ## ######## ######## ##     ##    ##       ##     ## ########  ######   ######  ##     ##  ######   ########

void enb_relay_message()
{
    char topic[128];

    sprintf(topic, "%s%s%s%s%s", LOC, TIP, NAME, XTRA, PUB);
    client.publish(topic, enb_buffer, false, 0);

    enb_clear_buffer(false);
}

//////////////////////////////////////////////////////////////////////////////////////////
//////////////////////////////////////////////////////////////////////////////////////////
//////////////////////////////////////////////////////////////////////////////////////////
// ######## ##       ##     ##  ######  ##     ##     ######  ######## ########  ####    ###    ##
// ##       ##       ##     ## ##    ## ##     ##    ##    ## ##       ##     ##  ##    ## ##   ##
// ##       ##       ##     ## ##       ##     ##    ##       ##       ##     ##  ##   ##   ##  ##
// ######   ##       ##     ##  ######  #########     ######  ######   ########   ##  ##     ## ##
// ##       ##       ##     ##       ## ##     ##          ## ##       ##   ##    ##  ######### ##
// ##       ##       ##     ## ##    ## ##     ##    ##    ## ##       ##    ##   ##  ##     ## ##
// ##       ########  #######   ######  ##     ##     ######  ######## ##     ## #### ##     ## ########

void enb_flush_serial_buffer()
{
    Serial.flush();
    while (Serial.read() >= 0)
        yield();
}

//////////////////////////////////////////////////////////////////////////////////////////
//////////////////////////////////////////////////////////////////////////////////////////
//////////////////////////////////////////////////////////////////////////////////////////